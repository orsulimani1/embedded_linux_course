## yocto_build/conf/local.conf
```bitbake
MACHINE ?= "beaglebone-yocto"
#MACHINE ?= "genericx86"
#MACHINE ?= "genericx86-64"
#MACHINE ?= "edgerouter"
#
# This sets the default machine to be qemux86-64 if no other machine is selected:
# MACHINE ??= "qemux86-64"
# Set the machine to qemu
# MACHINE = "qemuarm"
DISTRO ?= "poky"
# DISTRO ?= "poky-bleeding"

#
# Package Management configuration
#
PACKAGE_CLASSES ?= "package_rpm"

EXTRA_IMAGE_FEATURES ?= "debug-tweaks tools-debug"

USER_CLASSES ?= "buildstats"
PATCHRESOLVE = "noop"

#
# Disk Space Monitoring during the build
#
BB_DISKMON_DIRS ??= "\
    STOPTASKS,${TMPDIR},1G,100K \
    STOPTASKS,${DL_DIR},1G,100K \
    STOPTASKS,${SSTATE_DIR},1G,100K \
    STOPTASKS,/tmp,100M,100K \
    HALT,${TMPDIR},100M,1K \
    HALT,${DL_DIR},100M,1K \
    HALT,${SSTATE_DIR},100M,1K \
    HALT,/tmp,10M,1K"

#
# Yocto Project SState Mirror
#
#BB_HASHSERVE_UPSTREAM = "hashserv.yoctoproject.org:8686"
#SSTATE_MIRRORS ?= "file://.* http://sstate.yoctoproject.org/all/PATH;downloadfilename=PATH"

#
# Qemu configuration
#
# By default native qemu will build with a builtin VNC server where graphical output can be
# seen. The line below enables the SDL UI frontend too.
PACKAGECONFIG:append:pn-qemu-system-native = " sdl"
# By default libsdl2-native will be built, if you want to use your host's libSDL instead of 
# the minimal libsdl built by libsdl2-native then uncomment the ASSUME_PROVIDED line below.
#ASSUME_PROVIDED += "libsdl2-native"

CONF_VERSION = "2"
OE_TERMINAL = "tmux"



# Include useful tools
IMAGE_INSTALL:append = " i2c-tools usbutils"

# QEMU configuration
PACKAGECONFIG:append:pn-qemu-system-native = " sdl"
QB_OPT_APPEND = "-device virtio-net-pci,netdev=net0,mac=52:54:00:12:34:56 -netdev user,id=net0"

# Enable GPIO sysfs for QEMU
IMAGE_INSTALL:append = " kernel-modules"

# Make sure GPIO modules are loaded at boot
KERNEL_MODULE_AUTOLOAD += "gpio-mockup"
KERNEL_MODULE_PROBECONF += "gpio-mockup"
KERNEL_MODULE_PROBECONF_gpio-mockup = "options gpio_mockup_ranges=0,7"
KERNEL_CONFIG_APPEND = "CONFIG_GPIO_SYSFS=y"
IMAGE_INSTALL:append = " gpio-led-test"
```
